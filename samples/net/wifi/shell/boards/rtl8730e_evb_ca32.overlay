/*
 * Copyright (c) 2026 Realtek Semiconductor Corp.
 *
 * SPDX-License-Identifier: Apache-2.0
 *
 * CA32 as WHC WiFi host: enabling the two wifi netdev nodes (STA + SoftAP)
 * turns on CONFIG_WIFI_AMEBA and links the WHC IPC host blobs; the 802.11
 * driver runs on the KM4 and the MAC firmware on the KM0 (vendor images).
 */

&wifi0 {
	status = "okay";
};

&wifi1 {
	status = "okay";
};
