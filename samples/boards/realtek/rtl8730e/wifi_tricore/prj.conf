## sysbuild.conf
```
# One flashable app.bin from our images on all three cores: CA32 (default
# image, WHC host + WiFi shell), KM4 (WHC NP driver), KM0 (WiFi MAC firmware).
# The vendor IMG1 stays the bootloader; disabling MCUboot makes the CA32
# image-assembly step fold the KM4/KM0 image2 sub-images into app.bin.
SB_CONFIG_BOOTLOADER_NONE=y

SB_CONFIG_RTL8730E_BUILD_KM4_APP=y
SB_CONFIG_RTL8730E_KM4_APP_SOURCE_DIR="."
SB_CONFIG_RTL8730E_BUILD_KM0_APP=y
SB_CONFIG_RTL8730E_KM0_APP_SOURCE_DIR="."
```

## prj.conf
```kconfig
# Common to all three per-core images; everything role-specific lives in the
# boards/rtl8730e_evb_{ca32,km4,km0}.conf fragments.
CONFIG_EARLY_CONSOLE=y
CONFIG_HEAP_MEM_POOL_SIZE=4096

# All three cores share one LOGUART; serialize their output per line over a
# core-to-core HW semaphore so the console logs don't interleave mid-line.
CONFIG_UART_AMEBA_LOGUART_XCORE_LOCK=y
```

## boards/rtl8730e_evb_ca32.conf
```kconfig
# CA32: Zephyr network stack + WiFi shell, WHC host role (same shape as
# samples/net/wifi/shell with the rtl8730e_evb board fragment folded in).
CONFIG_NETWORKING=y
CONFIG_TEST_RANDOM_GENERATOR=y

CONFIG_MAIN_STACK_SIZE=5200
CONFIG_SHELL_STACK_SIZE=5200
CONFIG_NET_TX_STACK_SIZE=2048
CONFIG_NET_RX_STACK_SIZE=2048

CONFIG_NET_PKT_RX_COUNT=10
CONFIG_NET_PKT_TX_COUNT=10
CONFIG_NET_BUF_RX_COUNT=20
CONFIG_NET_BUF_TX_COUNT=20
CONFIG_NET_MAX_CONTEXTS=10
CONFIG_NET_DHCPV4=y

CONFIG_NET_IPV4=y
CONFIG_NET_IPV6=n

CONFIG_NET_TCP=y

CONFIG_NET_LOG=y
CONFIG_INIT_STACKS=y

CONFIG_NET_SHELL=y

CONFIG_WIFI=y
CONFIG_WIFI_LOG_LEVEL_ERR=y
CONFIG_NET_L2_WIFI_SHELL=y
CONFIG_NET_MGMT_EVENT_QUEUE_TIMEOUT=5000
CONFIG_NET_MGMT_EVENT_QUEUE_SIZE=16

# wifi shell's TWT commands use libm (frexp/ceil/ldexp/floor); the minimal
# libc has no libm, so use newlib (shipped with the ASDK gnuarmemb toolchain).
CONFIG_NEWLIB_LIBC=y

# The HAL os_wrapper guards on CONFIG_HEAP_MEM_POOL_SIZE directly; the WHC
# host tasks/semaphores/scan buffers live here.
CONFIG_HEAP_MEM_POOL_SIZE=262144
```

## boards/rtl8730e_evb_km0.conf
```kconfig
# KM0: WiFi MAC real-time firmware (lib_wifi_fw).  It registers its WL MAC
# interrupts through the HAL irq_register shim (needs dynamic interrupts).
CONFIG_WIFI_FW_EN=y
CONFIG_DYNAMIC_INTERRUPTS=y

# Firmware task stacks/semaphores come from the kernel heap.
CONFIG_HEAP_MEM_POOL_SIZE=16384
```

## boards/rtl8730e_evb_km4.conf
```kconfig
# KM4: WHC network-processor role -- 802.11 MAC/PHY driver + WHC IPC device
# (lib_wifi_whc_np; BT_COEXIST adds lib_coex via COEXIST_DEV).
CONFIG_AS_INIC_NP=y

# Driver tasks/semaphores/packet buffers come from the kernel heap.
CONFIG_HEAP_MEM_POOL_SIZE=131072
CONFIG_LOG_MODE_MINIMAL=y
```

## boards/rtl8730e_evb_ca32.overlay
```dts
/*
 * Copyright (c) 2026 Realtek Semiconductor Corp.
 *
 * SPDX-License-Identifier: Apache-2.0
 *
 * CA32 as WHC WiFi host: enabling the two wifi netdev nodes (STA + SoftAP)
 * turns on CONFIG_WIFI_AMEBA and links the WHC IPC host blobs; the 802.11
 * driver runs on the KM4 and the MAC firmware on the KM0 (the sibling
 * sysbuild images).
 */

&wifi0 {
	status = "okay";
};

&wifi1 {
	status = "okay";
};
```

## src/main.c
```c
/*
 * Copyright (c) 2026 Realtek Semiconductor Corp.
 *
 * SPDX-License-Identifier: Apache-2.0
 *
 * All cores idle in main; the WiFi shell runs in its own threads and the
 * KM4/KM0 WiFi roles are started by SYS_INITs in the HAL glue.
 */

int main(void)
{
	return 0;
}
```
