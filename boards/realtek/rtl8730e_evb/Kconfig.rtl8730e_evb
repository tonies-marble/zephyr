## boards/realtek/rtl8730e_evb/Kconfig.sysbuild
```kconfig
# Copyright (c) 2026 Realtek Semiconductor Corp.
# SPDX-License-Identifier: Apache-2.0

# The RTL8730E secure boot ROM validates and starts the MCUboot image on the
# KM4 core, which then chain-loads the signed application images.
choice BOOTLOADER
	default BOOTLOADER_MCUBOOT
endchoice

config RTL8730E_BUILD_KM4_APP
	bool "Build the KM4 network-processor application as a second image"
	help
	  When set, sysbuild builds the KM4 (Cortex-M55) application in addition to
	  the default application, so a single build produces both the CA32 and KM4
	  binaries. Requires RTL8730E_KM4_APP_SOURCE_DIR to point at the KM4 app.

config RTL8730E_KM4_APP_SOURCE_DIR
	string "Source directory of the KM4 application"
	depends on RTL8730E_BUILD_KM4_APP
	help
	  Absolute path (or path relative to APP_DIR) of the KM4 application that
	  sysbuild builds for the rtl8730e_evb/rtl8730e/km4 target.

config RTL8730E_BUILD_KM0_APP
	bool "Build the KM0 low-power application as a second image"
	help
	  When set, sysbuild builds the KM0 (Cortex-M23) application in addition to
	  the default application, so a single build produces the CA32, KM4 and KM0
	  binaries. Requires RTL8730E_KM0_APP_SOURCE_DIR to point at the KM0 app.
	  The KM0 app's packaged image2 is folded into the CA32 app.bin by the
	  non-MCUboot CA32 image-assembly path (merge_bin.py handle_amebasmart).

config RTL8730E_KM0_APP_SOURCE_DIR
	string "Source directory of the KM0 application"
	depends on RTL8730E_BUILD_KM0_APP
	help
	  Absolute path (or path relative to APP_DIR) of the KM0 application that
	  sysbuild builds for the rtl8730e_evb/rtl8730e/km0 target.
```

## boards/realtek/rtl8730e_evb/board.yml
```yaml
board:
  name: rtl8730e_evb
  full_name: RTL8730E Evaluation Board
  vendor: realtek
  socs:
    - name: rtl8730e
```

## drivers/led_strip/Kconfig.ameba
```kconfig
# Copyright (c) 2026 Realtek Semiconductor Corp.
# SPDX-License-Identifier: Apache-2.0

# Ameba led controller driver config
config LEDC_AMEBA
	bool "Ameba led controller driver"
	default y
	depends on DT_HAS_REALTEK_AMEBA_LEDC_ENABLED
	select PINCTRL
	select LED_STRIP_RGB_SCRATCH
	help
	  Enable support for Ameba led controller driver.

if LEDC_AMEBA

choice LEDC_AMEBA_TRANSFER_MODE
	prompt "Ameba LEDC transfer mode"
	default LEDC_AMEBA_CPU
	help
	  Select how pixel data is fed to the LEDC FIFO.

	config LEDC_AMEBA_CPU
		bool "CPU (interrupt-driven FIFO refill)"
		help
		  The CPU refills the LEDC FIFO from an interrupt handler each
		  time the FIFO level drops below the trigger threshold. No DMA
		  channel is required, but long chains risk a wait-data timeout
		  if interrupt latency is high.

	config LEDC_AMEBA_DMA
		bool "DMA"
		select DMA
		select CACHE_MANAGEMENT
		help
		  A GDMA channel feeds the LEDC FIFO via hardware handshake. The
		  CPU is only interrupted once per frame (on transfer finish),
		  making long chains robust against the wait-data timeout.
		  Requires a "tx" dmas entry on the ledc node and the GDMA
		  controller enabled.

endchoice

endif # LEDC_AMEBA
```

## drivers/mbox/Kconfig.realtek_ameba_ipc
```kconfig
# Copyright (c) 2026 Realtek Semiconductor Corp.
# SPDX-License-Identifier: Apache-2.0

config MBOX_REALTEK_AMEBA_IPC
	bool "Realtek RTL8730E (AmebaSmart) IPC mailbox driver"
	default y
	depends on DT_HAS_REALTEK_RTL8730E_IPC_ENABLED
	help
	  Driver for the Realtek RTL8730E (AmebaSmart) inter-processor
	  communication (IPC) doorbell, exposed as an MBOX controller whose
	  mbox cell is the absolute IPC register bit (0..31). Used for the
	  CA32 (host) <-> KM4 (remote) and CA32 (host) <-> KM0 (remote)
	  OpenAMP rpmsg links.
```

## drivers/serial/Kconfig.ameba_loguart
```kconfig
# Copyright (c) 2024 Realtek Semiconductor Corp.
# SPDX-License-Identifier: Apache-2.0

config UART_AMEBA_LOGUART
	bool "Ameba LOGUART driver"
	default y
	depends on DT_HAS_REALTEK_AMEBA_LOGUART_ENABLED
	select SERIAL_HAS_DRIVER
	select SERIAL_SUPPORT_INTERRUPT
	help
	  This option enables the LOGUART driver for Realtek Ameba SoCs.

config UART_AMEBA_LOGUART_XCORE_LOCK
	bool "Serialize LOGUART output across cores"
	depends on UART_AMEBA_LOGUART
	help
	  The RTL8730E LOGUART multiplexes a private per-core TX path from each
	  of CA32, KM4 and KM0 into one serial line at byte granularity, so
	  console output from cores running concurrently interleaves mid-line.
	  Enable this to buffer a line per core and flush it while holding a
	  core-to-core hardware semaphore, so each line reaches the wire intact.
	  Only useful when more than one core runs this driver (the tri-core
	  Zephyr build); leave it off for single-core images.

if UART_AMEBA_LOGUART_XCORE_LOCK

config UART_AMEBA_LOGUART_XCORE_LINE_MAX
	int "Per-core console line buffer size"
	default 128
	help
	  Bytes buffered per core before a flush.  A line longer than this is
	  flushed in chunks whose boundaries may interleave with other cores.

config UART_AMEBA_LOGUART_XCORE_SEM_ID
	int "Core-to-core hardware semaphore index"
	range 7 15
	default 15
	help
	  IPC hardware semaphore reserved for the console line flush.  IDs 0-6
	  are claimed by the vendor firmware (IMQ/FLASH/OTP/CRYPTO/DIAGNOSE/
	  SYSON/GDMA); pick a free one in 7-15.

endif # UART_AMEBA_LOGUART_XCORE_LOCK
```

## dts/bindings/led_strip/realtek,ameba-ledc.yaml
```yaml
# Copyright (c) 2026 Realtek Semiconductor Corp.
# SPDX-License-Identifier: Apache-2.0

description: Ameba Ledc

compatible: "realtek,ameba-ledc"

include: [base.yaml, pinctrl-device.yaml]

properties:

  pinctrl-0:
    required: true

  pinctrl-names:
    required: true

  chain-length:
    type: int
    required: true

  output-rgb-mode:
    type: int
    required: true

  # The timing properties below are raw LEDC register counts, not nanoseconds.
  # Per the LEDC register spec each count is one 40 MHz tick (25 ns).

  wait-data-timeout:
    type: int
    required: true

  data-tx-time0h:
    type: int
    required: true

  data-tx-time0l:
    type: int
    required: true

  data-tx-time1h:
    type: int
    required: true

  data-tx-time1l:
    type: int
    required: true

  refresh-time:
    type: int
    required: true

  color-mapping:
    type: array
    required: true

  dmas:
    description: |
      Optional TX DMA channel specifier, used only when CONFIG_LEDC_AMEBA_DMA
      is enabled. Format: <&dma channel slot config>, where "slot" is the
      LEDC TX handshake index (SoC specific) and "config" is the packed Ameba
      GDMA config cell (see realtek,ameba-gdma binding). Name it "tx".

  dma-names:
    description: Name of the DMA channel specifier, must be "tx".
```

## dts/bindings/mbox/realtek,rtl8730e-ipc.yaml
```yaml
# Copyright (c) 2026 Realtek Semiconductor Corp.
# SPDX-License-Identifier: Apache-2.0

description: |
  Realtek RTL8730E (AmebaSmart) inter-processor communication (IPC) mailbox.

  Each CPU (CA32/AP, KM4/NP, KM0/LP) owns a 5 x u32 IPC register block that acts
  as a doorbell controller with 8 channels per direction:

    0x00 TX_DATA : write BIT(channel) to signal the peer core
    0x04 RX_DATA : mirror of the peer's TX_DATA
    0x08 ISR     : RX-full / TX-empty status, write-1-to-clear
    0x0C IMR     : interrupt mask, 1 = unmask/enable
    0x10 ICR     : interrupt clear register

  The group shift is direction-dependent (see the vendor HAL
  ameba_ipc_api.c / ameba_ipc.h), so the single mbox cell is the ABSOLUTE
  register bit index (0..31) rather than a bare 0..7 channel.  This lets one
  driver serve every core pair by pushing the per-link bit-math into DT:

    TX_DATA doorbell : TX1 group = bits  0..7, TX0 group = bits  8..15
    ISR/IMR RX-full  : RX1 group = bits 16..23, RX0 group = bits 24..31

  Per link/direction (ch = the logical 0..7 channel of that link):

    AP_TO_NP (CA32->KM4)  TX bit ch+0    RX-full bit ch+16
    NP_TO_AP (KM4->CA32)  TX bit ch+0    RX-full bit ch+16
    AP_TO_LP (CA32->KM0)  TX bit ch+8    RX-full bit ch+16
    LP_TO_AP (KM0->CA32)  TX bit ch+0    RX-full bit ch+24

  A single interrupt line per core demuxes all bits.

  Model each block as an MBOX controller: the single mbox cell selects the
  absolute IPC register bit (0..31).

compatible: "realtek,rtl8730e-ipc"

include: [mailbox-controller.yaml, base.yaml]

properties:
  reg:
    required: true

  interrupts:
    required: true

  "#mbox-cells":
    const: 1

# The Zephyr mbox subsystem hard-codes the specifier cell name to "channel"
# (DT_MBOX_CHANNEL_BY_NAME -> DT_PHA_BY_NAME_OR(..., channel, 0)); any other name
# silently resolves to 0.  So the single cell -- the absolute IPC register bit
# (0..31) -- must be named "channel".
mbox-cells:
  - channel
```

## soc/realtek/ameba/amebasmart/Kconfig.defconfig
```kconfig
# Copyright (c) 2024 Realtek Semiconductor Corp.
# SPDX-License-Identifier: Apache-2.0

if SOC_SERIES_AMEBASMART

rsource "Kconfig.defconfig.rtl8730e.*"

endif # SOC_SERIES_AMEBASMART
```

## subsys/ipc/ipc_service/backends/Kconfig.rpmsg
```kconfig
# Copyright (c) 2021 Carlo Caione <ccaione@baylibre.com>
# SPDX-License-Identifier: Apache-2.0

if IPC_SERVICE_BACKEND_RPMSG

config IPC_SERVICE_BACKEND_RPMSG_WQ_STACK_SIZE
	int "Size of RX work queue stack"
	default 1024
	help
	  Size of stack used by work queue RX thread. This work queue is
	  created in the multi-instance / multi-core RPMsg backend module to
	  prevent notifying service users about received data from the system
	  work queue. Size is the same for all instances.

config IPC_SERVICE_BACKEND_RPMSG_SHMEM_RESET
	bool "Reset shared memory state"
	help
	  Some platforms retain the memory content upon reset. This is
	  problematic because the backend expects a zero-ed memory to be
	  able to correctly setup instances and endpoints at init time.
	  When this parameter is set to 'y' the status region of the shared
	  memory is reset on kernel initialization.

config IPC_SERVICE_BACKEND_RPMSG_SHMEM_RESET_REMOTE
	bool "Reset shared memory state also on the remote"
	help
	  Same as IPC_SERVICE_BACKEND_RPMSG_SHMEM_RESET, but applied to
	  instances with the 'remote' role.  On platforms where the shared
	  memory retains its content across a reset, a rebooting remote would
	  otherwise read the stale VDEV status left by the previous run
	  (including DRIVER_OK), skip waiting for the host and send its
	  one-shot name-service announcement into vrings the host has not set
	  up yet -- which the host then wipes during its own initialization,
	  leaving the endpoint unbindable.  Only enable this when the remote
	  is guaranteed to boot (and clear the status region) before the host
	  opens the instance, otherwise the remote can erase a live DRIVER_OK
	  written by an already-running host.

config IPC_SERVICE_BACKEND_RPMSG_NUM_ENDPOINTS_PER_INSTANCE
	int "Max number of registered endpoints per instance"
	default 2
	help
	  Maximal number of endpoints that can be registered for one instance
	  for RPMSG backend.

endif # IPC_SERVICE_BACKEND_RPMSG
```
